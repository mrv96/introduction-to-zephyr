## workspace/modules/ilps28qsw/drivers/Kconfig
```kconfig
# zephyr-keep-sorted-start
rsource "ilps28qsw/Kconfig"
# zephyr-keep-sorted-stop
```

## workspace/modules/ilps28qsw/drivers/ilps28qsw/Kconfig
```kconfig
config ILPS28QSW
    bool "ILPS28QSW pressure and temperature sensor"
    default n
    depends on DT_HAS_ST_ILPS28QSW_ENABLED
    select I2C
    help
        Enable driver for ILPS28QSW temperature sensor.
```

## workspace/modules/ilps28qsw/dts/bindings/sensor/st,ilps28qsw.yaml
```yaml
description: |
    STMicroelectronics ILPS28QSW pressure and temperature sensor.

compatible: "st,ilps28qsw"

include: [sensor-device.yaml, i2c-device.yaml]

properties:
  scale:
    type: int
    default: 0
    description: |
        Specify the full-scale mode.
        The default is the power-on reset value.

        - 0 # LPS28DFW_DT_FS_MODE_1_1260
        - 1 # LPS28DFW_DT_FS_MODE_2_4060
    enum: [0, 1]
```
