## CMakeLists.txt
```
cmake_minimum_required(VERSION 3.20.0)

set(ZEPHYR_EXTRA_MODULES "${CMAKE_SOURCE_DIR}/../../modules/say_hello")

find_package(Zephyr REQUIRED HINTS $ENV{ZEPHYR_BASE})
project(kconfig_float)

target_sources(app PRIVATE src/main.c)
```

## prj.conf
```kconfig
# CONFIG_SAY_HELLO=y
CONFIG_REQUIRES_FLOAT_PRINTF=y
CONFIG_TEST_RANDOM_GENERATOR=y
```

## boards/b_u585i_iot02a.conf
```kconfig
CONFIG_SERIAL=y # auto added saving minimal config
CONFIG_GPIO=y # auto added saving minimal config
CONFIG_CONSOLE=y # auto added saving minimal config
CONFIG_UART_CONSOLE=y # auto added saving minimal config
```

## src/main.c
```c
#include <zephyr/random/random.h>

#ifdef CONFIG_SAY_HELLO
#include "say_hello.h"
#endif

// Settings
static const int32_t sleep_time_ms = 1000;

int main(void)
{
    uint32_t rnd;
    double rnd_float;

    // Do forever
    while (1) {

        // Print random number
        rnd = sys_rand32_get();
        rnd_float = (double)rnd / (UINT32_MAX + 1.0);
        printk("Random value: %.3f\r\n", rnd_float);

#ifdef CONFIG_SAY_HELLO
        say_hello();
#endif

        // Sleep
        k_msleep(sleep_time_ms);
    }

    return 0;
}
```
